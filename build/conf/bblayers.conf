## build/conf/bblayers.conf
```bitbake
# POKY_BBLAYERS_CONF_VERSION is increased each time build/conf/bblayers.conf
# changes incompatibly
POKY_BBLAYERS_CONF_VERSION = "2"

BBPATH = "${TOPDIR}"
BBFILES ?= ""

BBLAYERS ?= " \
  /home/smalinux/repos/barebox-bbb/poky/meta \
  /home/smalinux/repos/barebox-bbb/poky/meta-poky \
  /home/smalinux/repos/barebox-bbb/poky/meta-yocto-bsp \
  /home/smalinux/repos/barebox-bbb/meta-openembedded/meta-oe \
  "
```

## meta-barebox-beaglebone/conf/layer.conf
```bitbake
# We have a conf and classes directory, add to BBPATH
BBPATH .= ":${LAYERDIR}"

# We have recipes-* directories, add to BBFILES
BBFILES += "${LAYERDIR}/recipes-*/*/*.bb \
            ${LAYERDIR}/recipes-*/*/*.bbappend"

BBFILE_COLLECTIONS += "meta-barebox-beaglebone"
BBFILE_PATTERN_meta-barebox-beaglebone = "^${LAYERDIR}/"
BBFILE_PRIORITY_meta-barebox-beaglebone = "6"

LAYERDEPENDS_meta-barebox-beaglebone = "core"
LAYERSERIES_COMPAT_meta-barebox-beaglebone = "styhead walnascar"
```
